#include <Arduino.h>
#include <Wire.h>                             //Biblioteca do I2C
#include <ArduinoJson.h>                      //Biblioteca de manipulação de JSON Documents
#include <SoftwareSerial.h>                   //Biblioteca da Comunicação serial via Software
#include <Adafruit_GFX.h>                     //Biblioteca do Display
#include <Adafruit_SSD1306.h>                 //Biblioteca do Display
#include <OneWire.h>                          //Biblioteca do Sensor de Temperatura
#include <DallasTemperature.h>                //Biblioteca do Sensor de Temperatura                
#include <WiFi.h>                             //Biblioteca do Wifi
#include <WebServer.h>                        //Biblioteca do Servidor do Portal
#include <DNSServer.h>                        //Biblioteca do webserver local usado para direcionar todas as requisições para o portal
#include <WiFiManager.h>                      //Biblioteca do Wifi Manager Magic
#include <FirebaseESP32.h>

#define   RXPIN                   16          //Pino Definido como RX
#define   TXPIN                   17          //Pino Definido como TX
#define   TEMPODERESPOSTA         1000        //Tempo de resposta 1 s
#define   TEMPODERESPOSTA2        500         //Tempo de resposta 500 ms
#define   TEMPODERESPOSTA3        10000       //Tempo de resposta 10 s
#define   SCREEN_WIDTH            128         // OLED display width, in pixels
#define   SCREEN_HEIGHT           64          // OLED display height, in pixels
#define   ONEWIREBUS              19          //Sensor de temperadura
#define   BT_UP                   25          //Porta do Botão UP
#define   BT_DOWN                 26          //Porta do Botão DOWN
#define   BT_ENTER                27          //Porta do Botão ENTER
#define FIREBASE_HOST             "wardio42.firebaseio.com"
#define FIREBASE_AUTH             "xXYerlIQicNQsa5tUOvzzJUoi2ds3BIKI6VFZsJ7"

DynamicJsonDocument doc(200);
SoftwareSerial pox(RXPIN, TXPIN);
Adafruit_SSD1306 display(SCREEN_WIDTH, SCREEN_HEIGHT, &Wire);
OneWire onewire(ONEWIREBUS);
DallasTemperature sensor(&onewire);
WiFiManager wifiManager;
FirebaseData firebaseData;

enum { MENU = 0, PAGE_1, PAGE_2, PAGE_3};
struct readings {
  int   bpm;					  // Beats per minute
  int   spo2;  				  // Oximetry in Percent	  ( %)
  float temp;  				  // Temperature in Celsius (°C)
} readings;

void  lerPox();
void  displayAtualizacao();
void  sensorAtualizacao();
void  lerBotao();
void  drawlogo(int i, int j);
void configModeCallback (WiFiManager *myWiFiManager);
void saveConfigCallback ();
void sendDataToFirebase(struct readings r);
void readDataForFirebase(struct readings *r);

ulong tsPox = 0, tsDisplay = 0, tsSensor = 0, tsBotao = 0, tsFirebase = 0;
uint16_t BPM = 0, SpO2 = 0;
uint8_t valor = 1, enter = 0, posicao_atual = 0;;
float_t temp = 0.00;
uint8_t tela = MENU;
bool stMode = false;

void setup() {
  Serial.begin(9600);
  pinMode(RXPIN, INPUT);
  pinMode(TXPIN, OUTPUT);
  pox.begin(9600);
  Wire.begin(); 
  if(!display.begin(SSD1306_SWITCHCAPVCC, 0x3c))
  {
    Serial.println("Erro ao iniciar o display");
    for(;;);
  }else
  {
    Serial.println("Display iniciado com sucesso");
  }
  drawlogo(4,1);
  display.clearDisplay();
  display.setTextColor(WHITE);
  display.display();

  sensor.begin();
  sensor.requestTemperaturesByIndex(0);
  temp = sensor.getTempCByIndex(0);

  pinMode(BT_DOWN, INPUT_PULLUP);
  pinMode(BT_UP, INPUT_PULLUP);
  pinMode(BT_ENTER, INPUT_PULLUP);
  wifiManager.autoConnect("WardIO");

  Firebase.begin(FIREBASE_HOST, FIREBASE_AUTH);
  Firebase.reconnectWiFi(true);
}
  

void loop() 
{
  if(millis() - tsBotao >= TEMPODERESPOSTA2)
  {
    lerBotao();
  }

  if(millis() - tsPox >= TEMPODERESPOSTA)
  {
    lerPox();
    if (BPM >= 40 && tela == MENU)
    {
      drawlogo(1,2);
    }
    
    tsPox = millis();
  }

  if(millis() - tsDisplay >= TEMPODERESPOSTA2)
  {
    displayAtualizacao();
    tsDisplay = millis();
  }

    if(millis() - tsSensor >= TEMPODERESPOSTA3)
  {
    void sensorAtualizacao();
    tsSensor = millis();
  }

  if(millis() - tsFirebase >= TEMPODERESPOSTA*2)
  {
    readDataForFirebase(&readings);
    sendDataToFirebase(readings);
  }
}

void lerPox()
{
  if(pox.available())
  {
    DeserializationError erro = deserializeJson(doc, pox);
  
    if(erro == DeserializationError::Ok)
    {
      Serial.print("Sensor: ");
      Serial.print(doc["sensor"].as<String>());
      Serial.print("/  BPM: ");
      BPM = doc["bpm"].as<int16_t>();
      Serial.print(BPM);
      Serial.print("/  Spo2: ");
      SpO2 = doc["spo2"].as<int16_t>();
      Serial.println(SpO2);
    }
    else
    {
      Serial.print("deserializantionError retornou: ");
      Serial.println(erro.c_str());
      BPM = 0;
      SpO2 = 0;
      if(tela == MENU)
      {
        drawlogo(1,3);
      }
      while (pox.available()>0)
      {
        pox.read();
      }
    }
  }else
  {      
    if(tela == MENU)
    {
      drawlogo(1,3);
    }
    Serial.println("Pox is no avalaible");
    pox.end();
    pox.begin(9600);
  }
}

void displayAtualizacao()
{
  display.clearDisplay();
  switch (tela)
  {
    case MENU:
    {
      if(enter == 1)
      {

        tela = PAGE_1;
        enter = 0;
        posicao_atual = 0;
      }
      display.clearDisplay();
      display.setCursor(0,0);
      display.setTextSize(2);
      display.print(BPM);
      display.print("BPM");
      display.setCursor(0,18);
      display.print(SpO2);
      display.print("%");
      display.setCursor(0,36);
      display.printf("%.1f",temp);
      display.drawCircle(55,37,2,WHITE);
      display.setCursor(58,36);
      display.print("C");
      display.setTextSize(1);
      display.setCursor(0,54);
      display.print("PRESS ENTER FOR MENU");
      display.display();
      break;
    }
    case PAGE_1:
    {
      display.clearDisplay();
      display.setTextSize(2);
      display.setCursor(13,5);
      display.print("INICIO");
      display.setCursor(1,22);
      display.print("STATUS WIFI");
      display.setCursor(10,39);
      display.print("RECONNECT");
        
      if (posicao_atual == 0)
        {
          Serial.println("Dentro do Item INICIO");
          display.drawRoundRect(0,4,128,16,5,1);
      }else if (posicao_atual == 1)
        {
          Serial.println("Dentro do Item STATUS WIFI");
          display.drawRoundRect(0,21,128,16,5,1);
        }else if (posicao_atual == 2)
        {
          Serial.println("Dentro do Item RECONECT");
          display.drawRoundRect(0,38,128,16,5,1);
        }
                
      display.display();
      Serial.println("valor ");
      Serial.print(valor);
      Serial.println("Posicao");
      Serial.print(posicao_atual);

      if (enter == 0 && valor == 2 && posicao_atual < 2)
      {
        Serial.println("dentro da soma");
        posicao_atual = posicao_atual +1;
        Serial.println(posicao_atual);
        valor = 1;
      }
      if (enter == 0 && valor == 0 && posicao_atual > 0)
      {
        Serial.println("Dentro da subtracao");
        posicao_atual= posicao_atual - 1;
        valor = 1;
      }
      if (enter == 1 && posicao_atual == 0)
      {
        tela = MENU;
        enter = 0;
        posicao_atual = 0;
      }
      if (enter == 1 && posicao_atual == 1)
      {
        tela = PAGE_2;
        enter = 0;
        posicao_atual = 0;
      }
      if (enter == 1 && posicao_atual == 2)
      {
        tela = PAGE_3;
        enter = 0;
        posicao_atual = 0;
      }
      break;
    }
    case PAGE_2:
    {       
      if(WiFi.isConnected())
      {
        display.clearDisplay();  
        display.setCursor(0,0);
        display.setTextSize(1);
        display.print("CONECTADO COMO");
        display.setCursor(0,15);
        display.setTextSize(1);
        display.print(WiFi.SSID());
        display.display();
      }else
      {
        display.clearDisplay();  
        display.setCursor(10,10);
        display.setTextSize(2);
        display.print("Não Conectado");
        display.setCursor(10,15);
        display.display();
        if (stMode)
        {
          display.setTextSize(1);
          display.print("Entrar no endereço:");
          display.setCursor(0,20);
          display.print(WiFi.softAPIP());
          display.display();
        }else
        {
          display.setTextSize(1);
          display.setCursor(10,10);
          display.print("Entar no modo de RECONNECT");
          display.display();
        }
      }
      
      if(enter == 1)
      {
        tela = MENU;
        enter = 0;
      }    
      break;
    }
    case PAGE_3:
    {
      display.clearDisplay();
      display.setCursor(0,0);
      display.setTextSize(1);
      display.print("MODO DE CONFIGURACAO");
      display.setCursor(0,9);
      display.print("ATIVADO ");
      display.setCursor(0,18);
      display.print("CONECTE NA REDE");
      display.setCursor(0,27);
      display.print("WardIO");
      display.setCursor(0,36);
      display.print("NO IP");
      display.setCursor(0,45);
      display.print("192.168.4.1");
      display.display();
 
      if(enter == 1)
      {
        WiFiManager wifiManager;
        if(!wifiManager.startConfigPortal("WardIO") )
        {
          Serial.println("Falha ao conectar");
          delay(2000);
          ESP.restart();
        }
        tela = MENU;
        enter = 0;
      } 
      break;
    }
    default:
      break;
    }
}

void sensorAtualizacao(struct readings *r)
{
  sensor.requestTemperaturesByIndex(0);
  temp = sensor.getTempCByIndex(0);
  Serial.print(temp);
  Serial.println("°C");
  readings.temp = temp;
}

void lerBotao()
{
  if(!digitalRead(BT_ENTER))
  {
    enter = 1;
    tsBotao = millis();
  }else if (!digitalRead(BT_UP))
  {
    valor = 2;
    tsBotao = millis();
  }else if (!digitalRead(BT_DOWN))
  {
    valor = 0;
    tsBotao = millis();
  }    
}


void configModeCallback (WiFiManager *myWiFiManager)
{
  Serial.println("Entrou no modo de configuração");
  Serial.println(WiFi.softAPIP()); //imprime o IP do AP
  Serial.println(myWiFiManager->getConfigPortalSSID()); //imprime o SSID criado da rede
  stMode = true;
}

void saveConfigCallback ()
{
  Serial.println("Rede Salva");
  stMode = false;
}

void readDataForFirebase(struct readings *r)
{
  readings.bpm = BPM;
  readings.spo2 = SpO2;
  readings.temp = temp;
}

void sendDataToFirebase(struct readings r)
{
  if (!Firebase.pushInt(firebaseData,"BPM", r.bpm)) 
  {
    Serial.print("[ERROR] pushing BPM failed:");
  }else
  {
    Serial.print("Sending BPM");
  }
  
  if (!Firebase.pushInt(firebaseData,"SpO2", r.spo2)) 
  {
    Serial.print("[ERROR] pushing SpO2 failed:");
  }else
  {
    Serial.print("Sending SpO2");
  }
  if (!Firebase.pushInt(firebaseData,"Temperatura", r.temp)) 
  {
    Serial.println("[ERROR] pushing Temp failed:");
  }else
  {
    Serial.println("Sending Temp");
  }
}


void drawlogo(int i, int j)
{
  
  static const unsigned char logo_bmp_128x42_1 [] PROGMEM = {
  // 'logo_bmp_128x42', 74x64px
  0xff, 0xfe, 0x00, 0xff, 0xff, 0xff, 0xc0, 0x1f, 0xff, 0xc0, 0xff, 0xf0, 0x00, 0x1f, 0xff, 0xfe, 
  0x00, 0x03, 0xff, 0xc0, 0xff, 0xc0, 0x00, 0x07, 0xff, 0xf8, 0x00, 0x00, 0xff, 0xc0, 0xff, 0x00, 
  0x00, 0x01, 0xff, 0xe0, 0x00, 0x00, 0x3f, 0xc0, 0xfe, 0x00, 0x00, 0x00, 0xff, 0xc0, 0x00, 0x38, 
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  0xe1, 0xff, 0xff, 0xff, 0xff, 0xc0, 0xff, 0xff, 0xff, 0xff, 0xf3, 0xff, 0xff, 0xff, 0xff, 0xc0
  };
  static const unsigned char logo_bmp_128x42_2 [] PROGMEM = {
  // 'logo_bmp_128x42', 74x64px
  0x00, 0x01, 0xff, 0x00, 0x00, 0x00, 0x3f, 0xe0, 0x00, 0x00, 0x00, 0x0f, 0xff, 0xe0, 0x00, 0x01, 
  0xff, 0xfc, 0x00, 0x00, 0x00, 0x3f, 0xff, 0xf8, 0x00, 0x07, 0xff, 0xff, 0x00, 0x00, 0x00, 0xff, 
  0xff, 0xfe, 0x00, 0x1f, 0xff, 0xff, 0xc0, 0x00, 0x01, 0xff, 0xff, 0xff, 0x00, 0x3f, 0xff, 0xc7, 
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  0x1e, 0x00, 0x00, 0x00, 0x00, 0x00, 0x00, 0x00, 0x00, 0x00, 0x0c, 0x00, 0x00, 0x00, 0x00, 0x00
  };
  
  static const unsigned char logo_bmp_18x16_1 [] PROGMEM ={
    // 'logo_bmp_128x42', 18x16px
    0x1e, 0x1e, 0x00, 0x7f, 0x3e, 0x80, 0x7f, 0xfe, 0x00, 0xff, 0xff, 0x40, 0xff, 0xff, 0x40, 0xff, 
    0xff, 0x40, 0xff, 0xff, 0x40, 0x7f, 0xff, 0x80, 0x7f, 0xff, 0x80, 0x3f, 0xff, 0x00, 0x1f, 0xfe, 
    0x00, 0x0f, 0xfc, 0x00, 0x07, 0xf8, 0x00, 0x03, 0xf0, 0x00, 0x01, 0xe0, 0x00, 0x00, 0xc0, 0x00};
  
  static const unsigned char logo_bmp_18x16_2 [] PROGMEM={
    // 'coracao-partido Freepik', 18x16px
    0x00, 0x00, 0x00, 0x1c, 0x0e, 0x00, 0x3f, 0x3f, 0x00, 0x7f, 0x7f, 0x80, 0x7e, 0xff, 0x80, 0x7d, 
    0xff, 0x80, 0x7e, 0xff, 0x80, 0x3f, 0x7f, 0x00, 0x1f, 0xbe, 0x00, 0x0f, 0xdc, 0x00, 0x07, 0xb8, 
    0x00, 0x03, 0xb0, 0x00, 0x01, 0xc0, 0x00, 0x00, 0xc0, 0x00, 0x00, 0x00, 0x00, 0x00, 0x00, 0x00};

  for(int a = 0; a<i; a++ )
  {
    if (j == 1){
      /*dispay.drawBitmap(pos x,pos y,*logo,LOGO_WIDTH,LOGO_HEIGHT,1);*/
      display.clearDisplay();
      display.drawBitmap(27, 0,  logo_bmp_128x42_1, 74, 64, WHITE);
      display.display();
      delay(250);
      display.clearDisplay();
      display.drawBitmap(27, 0,  logo_bmp_128x42_2, 74, 64, WHITE);
      display.display();
      delay(250);
    }else if( j==2)
    {
      display.drawBitmap(100, 0,  logo_bmp_18x16_1, 18, 16, WHITE);
      display.display();
    }else if(j==3)
    {
      display.drawBitmap(100, 0,  logo_bmp_18x16_2, 18, 16, WHITE);
      display.display();
    }
    
  }
}
